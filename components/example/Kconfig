## components/example/Kconfig
```kconfig
menu "Example Component Config"
    config EXAMPLE_COMPONENT_FLAG
    bool "Example component flag"
    default n
    help
        Set this flag to print extra message.
endmenu
```

## main/Kconfig.projbuild
```kconfig
menu "Example configuration"
    config EXAMPLE_VALUE
        int "Example config value"
        default 420
        help
            This is example config value help.
endmenu
```
